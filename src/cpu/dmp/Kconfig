## src/mainboard/dmp/3300mx/Kconfig
```kconfig
if BOARD_DMP_3300MX

config BOARD_SPECIFIC_OPTIONS # dummy
	def_bool y
	select ARCH_X86
	select CPU_DMP_VORTEX86MX
	select NORTHBRIDGE_DMP_VORTEX86MX
	select SOUTHBRIDGE_DMP_VORTEX86MX
	select SOUTHBRIDGE_RICOH_RL5C476
	select BOARD_HAS_FADT
	select HAVE_OPTION_TABLE
	select HAVE_PIRQ_TABLE
	select HAVE_ACPI_TABLES
	select BOARD_ROMSIZE_KB_256
	select ROMCC

config MAINBOARD_DIR
	string
	default dmp/3300mx

config MAINBOARD_PART_NUMBER
	string
	default "3300MX"

config IRQ_SLOT_COUNT
	int
	default 5

endif # BOARD_DMP_3300MX
```

## src/mainboard/dmp/Kconfig
```kconfig
if VENDOR_DMP

choice
	prompt "Mainboard model"

config BOARD_DMP_3300MX
	bool "3300MX"

endchoice

source "src/mainboard/dmp/3300mx/Kconfig"

config MAINBOARD_VENDOR
	string
	default "DMP"

endif # VENDOR_DMP
```
